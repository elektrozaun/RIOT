## drivers/w5500/Kconfig
```kconfig
# Copyright (C) 2022 Frankfurt University of Applied Sciences
#
# This file is subject to the terms and conditions of the GNU Lesser
# General Public License v2.1. See the file LICENSE in the top level
# directory for more details.
#

config MODULE_W5500
    bool "W5500 Ethernet Adapter"
    depends on TEST_KCONFIG
    depends on HAS_PERIPH_GPIO
    depends on HAS_PERIPH_GPIO_IRQ
    depends on HAS_PERIPH_SPI
    select MODULE_LUID
    select MODULE_NETDEV_ETH
    select MODULE_NETDEV_LEGACY_API
    select MODULE_PERIPH_GPIO
    select MODULE_PERIPH_GPIO_IRQ
    select MODULE_PERIPH_SPI

config HAVE_W5500
    bool
    select MODULE_W5500 if MODULE_NETDEV_DEFAULT
    help
        Indicates that a w5500 ethernet adapter is present.
```
